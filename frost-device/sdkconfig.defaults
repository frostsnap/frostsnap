## frost-device/sdkconfig.defaults
```kconfig
# Rust often needs a bit of an extra main task stack size compared to C (the default is 3K)
CONFIG_ESP_MAIN_TASK_STACK_SIZE=20000

# Use this to set FreeRTOS kernel tick frequency to 1000 Hz (100 Hz by default).
# This allows to use 1 ms granuality for thread sleeps (10 ms by default).
CONFIG_FREERTOS_HZ=1000

# Workaround for https://github.com/espressif/esp-idf/issues/7631
CONFIG_MBEDTLS_CERTIFICATE_BUNDLE=n
CONFIG_MBEDTLS_CERTIFICATE_BUNDLE_DEFAULT_FULL=n

CONFIG_ESP_INT_WDT=n
# CONFIG_ESP_TASK_WDT=n
# CONFIG_TASK_WDT_TIMEOUT_S=10000
# CONFIG_ESP_INT_WDT_TIMEOUT_MS=10000
```

## frostsnap_factory/bootloader/sdkconfig.defaults
```kconfig
CONFIG_IDF_TARGET="esp32c3"
CONFIG_SECURE_BOOT=y
CONFIG_SECURE_BOOT_V2_ENABLED=y
CONFIG_SECURE_BOOT_BUILD_SIGNED_BINARIES=n
CONFIG_SECURE_SIGNED_ON_BOOT_NO_SECURE_BOOT=n
CONFIG_SECURE_BOOT_INSECURE=y
CONFIG_SECURE_BOOT_V2_ALLOW_EFUSE_RD_DIS=y
CONFIG_SECURE_BOOT_ALLOW_UNUSED_DIGEST_SLOTS=y
CONFIG_SECURE_DISABLE_ROM_DL_MODE=y
CONFIG_BOOTLOADER_APP_ROLLBACK_ENABLE=y
CONFIG_BOOTLOADER_APP_ANTI_ROLLBACK=y
CONFIG_BOOTLOADER_COMPILER_OPTIMIZATION_SIZE=y
CONFIG_BOOTLOADER_WDT_ENABLE=y
CONFIG_PARTITION_TABLE_OFFSET=0xD000
CONFIG_ESPTOOLPY_FLASHSIZE_4MB=y
CONFIG_BOOTLOADER_COMPILE_TIME_DATE=n
CONFIG_BOOT_ROM_LOG_ALWAYS_OFF=y
CONFIG_BOOTLOADER_LOG_LEVEL_NONE=y
```

## frostsnap_factory/bootloader/sdkconfig.defaults.dev
```kconfig
CONFIG_SECURE_BOOT=n
CONFIG_SECURE_BOOT_V2_ENABLED=n
CONFIG_SECURE_BOOT_BUILD_SIGNED_BINARIES=n
CONFIG_SECURE_SIGNED_ON_BOOT_NO_SECURE_BOOT=n
CONFIG_SECURE_BOOT_ALLOW_JTAG=y
CONFIG_SECURE_INSECURE_ALLOW_DL_MODE=y
CONFIG_BOOT_ROM_LOG_ALWAYS_ON=y
CONFIG_BOOTLOADER_LOG_LEVEL_INFO=y
```
